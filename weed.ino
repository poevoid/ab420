//it's 420 y'all

#include <Arduboy2.h>
Arduboy2 arduboy;
#define LOGO_WIDTH 32
#define LOGO_HEIGHT 32
#define NUMFLAKES 8
const unsigned char weed[] PROGMEM = {
  32,32,
0x00,0x00,0x00,0x00,0x00,0x80,0x40,0x80,0x00,0x00,0x00,0x00,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0x00,
0x00,0x00,0x00,0x00,0x00,0x00,0x00,0x00,0x00,0x00,0x00,0x00,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0x00

};
void setup() {
  // put your setup code here, to run once:
  arduboy.begin();
  arduboy.initRandomSeed();
}

void loop() {
  // put your main code here, to run repeatedly
  testanimate(weed, 32, 32);
  arduboy.print(F("GO DOWNLOAD ME \n A HOAGIE OFF THE INTERNET"));
}


#define XPOS   0 // Indexes into the 'icons' array in function below
#define YPOS   1
#define DELTAY 2

void testanimate(const uint8_t *bitmap, uint8_t w, uint8_t h) {
  int8_t f;
  int8_t icons[NUMFLAKES][3];

  // Initialize 'snowflake' positions
  for(f=0; f< NUMFLAKES; f++) {
    icons[f][XPOS]   = random(1 - LOGO_WIDTH, WIDTH);
    icons[f][YPOS]   = -LOGO_HEIGHT;
    icons[f][DELTAY] = random(1, 6);
    Serial.print(F("x: "));
    Serial.print(icons[f][XPOS], DEC);
    Serial.print(F(" y: "));
    Serial.print(icons[f][YPOS], DEC);
    Serial.print(F(" dy: "));
    Serial.println(icons[f][DELTAY], DEC);
  }

  for(;;) { // Loop forever...
    arduboy.clear(); // Clear the display buffer

    // Draw each snowflake:
    for(f=0; f< NUMFLAKES; f++) {
      Sprites::drawSelfMasked(icons[f][XPOS], icons[f][YPOS], weed, 0);
    }
    arduboy.setCursor(0, HEIGHT/2-8);
    arduboy.print(F("GO DOWNLOAD ME \n A HOAGIE OFF THE \n INTERNET"));
    arduboy.display(); // Show the display buffer on the screen
    delay(200);        // Pause for 1/10 second

    // Then update coordinates of each flake...
    for(f=0; f< NUMFLAKES; f++) {
      icons[f][YPOS] += icons[f][DELTAY];
      // If snowflake is off the bottom of the screen...
      if (icons[f][YPOS] >= HEIGHT) {
        // Reinitialize to a random position, just off the top
        icons[f][XPOS]   = random(1 - LOGO_WIDTH, WIDTH);
        icons[f][YPOS]   = -LOGO_HEIGHT;
        icons[f][DELTAY] = random(1, 6);
      }
    }
  }
}
